## components/bk3515_ota/Kconfig
```kconfig
menu "BK3515_OTA"

    config BK3515_OTA
        bool "Enable bk3515 ota, Send data via uart"
        default n
endmenu
```

## components/bk_mp3_play/Kconfig
```kconfig
menu "BK_MP3_Play"

	config MP3_PLAY
		depends on ADK_RAW_STREAM && ADK_MP3_DECODER && ADK_ONBOARD_SPEAKER_STREAM
		bool "Enable MP3 Play"
		default n

	config MP3_PLAY_TEST
		depends on MP3_PLAY
		bool "Enable MP3 Play Test"
		default n

endmenu
```

## components/blue_audio_player_service/Kconfig
```kconfig
menu "Blue Audio Player Service"

	config BLUE_AUDIO_PLAYER_SERVICE
		depends on ADK_RAW_STREAM && (ADK_SBC_DECODER || ADK_AAC_DECODER) && (ADK_ONBOARD_SPEAKER_STREAM || ADK_UAC_SPEAKER_STREAM || ADK_I2S_STREAM)
		bool "Enable Blue Audio Player Service"
		default n
		help
			Enable Blue Audio Player Service to play audio frame data recevied from Bluetooth

	config BLUE_AUDIO_PLAYER_SERVICE_TEST
		depends on BLUE_AUDIO_PLAYER_SERVICE
		bool "Enable Blue Audio Player Service Test"
		default n
		help
			Enable Blue Audio Player Service test to test Blue Audio Player Service by cli command

    config BLUE_AUDIO_PLAYER_SERVICE_SUPPORT_AAC_DECODER
		depends on BLUE_AUDIO_PLAYER_SERVICE && ADK_AAC_DECODER
		bool "Enable Blue Audio Player Service to support aac decoder"
		default n

    config BLUE_AUDIO_PLAYER_SERVICE_SUPPORT_LC3_DECODER
		depends on BLUE_AUDIO_PLAYER_SERVICE && ADK_LC3_DECODER
		bool "Enable Blue Audio Player Service to support lc3 decoder"
		default n
		help
			The LC3 decoder is not supported yet and will be adapted later

    config BLUE_AUDIO_PLAYER_SERVICE_SUPPORT_UAC_SPEAKER
		depends on BLUE_AUDIO_PLAYER_SERVICE && ADK_UAC_SPEAKER_STREAM
		bool "Enable Blue Audio Player Service to support uac speaker"
		default n

    config BLUE_AUDIO_PLAYER_SERVICE_SUPPORT_I2S_SPEAKER
		depends on BLUE_AUDIO_PLAYER_SERVICE && ADK_I2S_STREAM
		bool "Enable Blue Audio Player Service to support i2s speaker"
		default n

    config BLUE_AUDIO_PLAYER_SERVICE_SUPPORT_MIX
		depends on BLUE_AUDIO_PLAYER_SERVICE && ADK_MIX_ALGORITHM
		bool "Enable Blue Audio Player Service to support mix algorithm"
		default n

    config BLUE_AUDIO_PLAYER_SERVICE_SUPPORT_EQ
		depends on BLUE_AUDIO_PLAYER_SERVICE && ADK_EQ_ALGORITHM
		bool "Enable Blue Audio Player Service to support EQ algorithm"
		default n
		help
			Enable EQ algorithm support in Blue Audio Player Service for audio equalization processing

endmenu
```

## components/blue_audio_recorder_service/Kconfig
```kconfig
# KCONFIG_GROUP: Solution & Product
menu "Blue Audio Recorder Service"

    config BLUE_AUDIO_RECORDER_SERVICE
        depends on ADK_RAW_STREAM && ADK_ONBOARD_MIC_STREAM
        bool "Enable Blue Audio Recorder Service"
        default y
        help
            Enable Blue Audio Recorder Service to record audio frame data and encode it for Bluetooth transmission

    config BLUE_AUDIO_RECORDER_SERVICE_TEST
        depends on BLUE_AUDIO_RECORDER_SERVICE
        bool "Enable Blue Audio Recorder Service Test"
        default n
        help
            Enable Blue Audio Recorder Service test to test Blue Audio Recorder Service by cli command

    config BLUE_AUDIO_RECORDER_SERVICE_SUPPORT_UAC_MIC
        depends on BLUE_AUDIO_RECORDER_SERVICE && ADK_UAC_MIC_STREAM
        bool "Enable Blue Audio Recorder Service to support uac mic"
        default n

    config BLUE_AUDIO_RECORDER_SERVICE_SUPPORT_MSBC_ENCODER
        depends on BLUE_AUDIO_RECORDER_SERVICE && ADK_SBC_ENCODER
        bool "Enable Blue Audio Recorder Service to support msbc encoder"
        default n

    config BLUE_AUDIO_RECORDER_SERVICE_SUPPORT_EQ
        depends on BLUE_AUDIO_RECORDER_SERVICE && ADK_EQ_ALGORITHM
        bool "Enable Blue Audio Recorder Service to support EQ algorithm"
        default n
        help
            Enable EQ algorithm support in Blue Audio Recorder Service for audio equalization processing

endmenu
```

## components/sw_sbc_decoder/Kconfig
```kconfig
menu "SW SBC Decoder"

	config SW_SBC_DECODER
		bool "Enable Software SBC Decoder"
		default n
		help
			Enable software SBC decoder for A2DP audio playback
			on chips without hardware SBC accelerator (e.g. BK7259).

	config PIPELINE_DEBUG_STAGE
		depends on SW_SBC_DECODER
		int "Pipeline debug cutoff stage"
		default 0
		help
			0 = normal passthrough
			1 = cutoff at decoder (dump to UART2, no forward to mix_alg)
			2 = cutoff at pcm_tap (dump to UART2, no forward to speaker)
			Use to pinpoint which stage causes send queue failed.

endmenu
```

## projects/scooter/ap/Kconfig.projbuild
```kconfig
menu "scooter Example Configuration"

    config A2DP_SINK_DEMO
        bool "a2dp sink demo"
        depends on BT
        default y

    config HFP_HF_DEMO
        bool "hfp hf demo"
        depends on BT
        default n

    config BLUETOOTH_BSC_UART_ID
        int "bluetooth secondary controller uart id, see UART_ID_0 == 0"
        range 0 2
        depends on BLUETOOTH_MULTI_CONTROLLER
        default 2

    config BLUETOOTH_BSC_RESET_PIN
        int "bluetooth secondary controller reset pin"
        depends on BLUETOOTH_MULTI_CONTROLLER
        default 38
    
    config BLUETOOTH_BSC_CTS_PIN
        int "bluetooth secondary controller cts pin"
        depends on BLUETOOTH_MULTI_CONTROLLER
        default 28

    config BLUETOOTH_BSC_RTS_PIN
        int "bluetooth secondary controller rts pin"
        depends on BLUETOOTH_MULTI_CONTROLLER
        default 29

    config BLUETOOTH_BSC_INIT_BAUD
        int "bluetooth secondary controller init baud"
        depends on BLUETOOTH_MULTI_CONTROLLER
        default 115200

    config BLUETOOTH_BSC_NEGO_BAUD
        int "bluetooth secondary controller nego baud"
        depends on BLUETOOTH_MULTI_CONTROLLER
        default 2000000

    config MEDIA_RECEIVE_DEMO
        bool "media receive other device data"
        depends on MEDIA
        default n

    config MEDIA_DEMO_MODE_TCP
        bool "MEDIA RECEIVE DEMO USE TCP MODE"
        depends on MEDIA_RECEIVE_DEMO
        default n

    config BK3515_OTA
        bool "Enable bk3515 ota, Send data via uart"
        default n
endmenu
```

## projects/scooter_1024_600/ap/Kconfig.projbuild
```kconfig
menu "scooter Example Configuration"

    config MEDIA_RECEIVE_DEMO
        bool "media receive other device data"
        depends on MEDIA
        default n

    config MEDIA_DEMO_MODE_TCP
        bool "MEDIA RECEIVE DEMO USE TCP MODE"
        depends on MEDIA_RECEIVE_DEMO
        default n

    config LCD_PANEL_USE_1024X600
        bool "LCD Panel Use 1024x600"
        default y

    config AVI_PLAYER_WITHOUT_LVGL
        bool "Enable AVI Player without LVGL"
        default n
endmenu
```

## projects/scooter_480_272_v2/ap/Kconfig.projbuild
```kconfig
menu "Scooter_480_272_v2 Example Configuration"

    config MEDIA_RECEIVE_DEMO
        bool "media receive other device data"
        depends on MEDIA
        default n

    config MEDIA_DEMO_MODE_TCP
        bool "MEDIA RECEIVE DEMO USE TCP MODE"
        depends on MEDIA_RECEIVE_DEMO
        default n

    config LCD_PANEL_USE_480X272
        bool "LCD Panel Use 480x272"
        default y

    config AVI_PLAYER_WITHOUT_LVGL
        bool "Enable AVI Player without LVGL"
        default n
endmenu
```

## projects/scooter_800_480_v2/ap/Kconfig.projbuild
```kconfig
menu "Scooter_800_480_v2 Example Configuration"

    config MEDIA_RECEIVE_DEMO
        bool "media receive other device data"
        depends on MEDIA
        default n

    config MEDIA_DEMO_MODE_TCP
        bool "MEDIA RECEIVE DEMO USE TCP MODE"
        depends on MEDIA_RECEIVE_DEMO
        default n

    config LCD_PANEL_USE_800X480
        bool "LCD Panel Use 800x480"
        default y

    config AVI_PLAYER_WITHOUT_LVGL
        bool "Enable AVI Player without LVGL"
        default n
endmenu
```

## projects/scooter_dashboard_klok_1280_720/ap/Kconfig.projbuild
```kconfig
menu "Klok"

config PROJECT_LCD_RESET_PIN
	int
	default 42

config PROJECT_LCD_BACKLIGHT_PIN
	int "LCD BACKLIGHT PIN"
	default 46
	help
	  New scooter dashboard board uses GPIO_46 for LCD backlight.

config PROJECT_SCOOTER_DASHBOARD_V_1_0
	bool "SCH-7259 V1.0 board"
	default y
	help
	  Select the five-key GPIO layout used by the SCH-7259 V1.0 board.

endmenu
```

## projects/scooter_dashboard_klok_fl7703_1280_720/ap/Kconfig.projbuild
```kconfig
menu "Klok"

config PROJECT_LCD_RESET_PIN
	int
	default 60

config PROJECT_SCOOTER_DASHBOARD_V_1_0
	bool "SCH-7259 V1.0 board"
	default y
	help
	  Select the five-key GPIO layout used by the SCH-7259 V1.0 board.

endmenu
```

## projects/scooter_dashboard_v1_1024_600_v2/ap/Kconfig.projbuild
```kconfig
menu "PROJECT Configuration"
    config PROJECT_SCOOTER_V2
        bool "PROJECT_SCOOTER_V2"
        default n

    config PROJECT_SCOOTER_DASHBOARD_V_1_0
        bool "Scooter Dashboard V1.0 board"
        default n

    config PROJECT_LCD_RESET_PIN
        int "LCD RESET PIN"
        default 60

    config PROJECT_LCD_BACKLIGHT_PIN
        int "LCD BACKLIGHT PIN"
        default 46
endmenu

menu "LVGL Widgets_v9 Configuration"

    config LV_USE_DEMO_WIDGETS
        bool "Enable LV_USE_DEMO_WIDGETS"
        default n
endmenu


menu "Scooter media / display configuration"
    config MEDIA_RECEIVE_DEMO
        bool "Media receive demo (SDP + TCP image transfer for app search)"
        default y

    config MEDIA_DEMO_MODE_TCP
        bool "MEDIA RECEIVE DEMO USE TCP MODE"
        depends on MEDIA_RECEIVE_DEMO
        default n

    config MEDIA_PIPELINE
        bool "Enable media pipeline (frame queue + decode)"
        default n

    comment "LVGL vendor framebuffer (lv_vendor_init width/height) — 1024x600 project defaults"

    config SCOOTER_LVGL_HOR_RES
        int "LVGL horizontal resolution (lv_vendor width)"
        default 1024
        range 1 10000

    config SCOOTER_LVGL_VER_RES
        int "LVGL vertical resolution (lv_vendor height)"
        default 600
        range 1 10000

    config SCOOTER_UI_ROTATION
        int "LVGL rotation (degrees: 0, 90, 180, 270)"
        default 180
        range 0 270

    comment "UI designer canvas (beken_ui SCREEN_* and root page size)"

    config SCOOTER_UI_CANVAS_WIDTH
        int "UI canvas width (SCREEN_WIDTH, root page)"
        default 1024
        range 1 10000

    config SCOOTER_UI_CANVAS_HEIGHT
        int "UI canvas height (SCREEN_HEIGHT, root page)"
        default 600
        range 1 10000

    config SCOOTER_BOOT_BG_FILENAME
        string "Boot background JPEG filename on SD card"
        default "home_bg_tech_1024_600.jpg"

    comment "Cast JPEG pipeline (src/dst in pixels; rotate in degrees)"

    config SCOOTER_CAST_JPEG_SRC_WIDTH
        int "Cast JPEG source width"
        default 1024
        range 1 10000

    config SCOOTER_CAST_JPEG_SRC_HEIGHT
        int "Cast JPEG source height"
        default 600
        range 1 10000

    config SCOOTER_CAST_JPEG_DST_WIDTH
        int "Cast JPEG destination width"
        default 1024
        range 1 10000

    config SCOOTER_CAST_JPEG_DST_HEIGHT
        int "Cast JPEG destination height"
        default 600
        range 1 10000

    config SCOOTER_CAST_JPEG_ROTATE_DEG
        int "Cast JPEG rotate degree"
        default 0
        range 0 270

    comment "Music player volume (digital gain in dB)"

    config MUSIC_PLAYER_VOLUME_DB_MIN
        int "Minimum music player volume"
        default -100
        range -100 12

    config MUSIC_PLAYER_VOLUME_DB_MAX
        int "Maximum music player volume"
        default 12
        range -100 12

    config MUSIC_PLAYER_INITIAL_VOLUME_DB
        int "Initial music player volume"
        default -40
        range -100 12

    config MUSIC_PLAYER_VOLUME_STEP_DB
        int "Music player volume adjustment step"
        default 3
        range 1 112
endmenu
```
